/*
 * ═══════════════════════════════════════════════
 *  HAMMERSPOON DECK — ESP32 + OLED 0.96"
 *  Menú estilo Batocera/Pip-Boy: al bajar/subir un item se
 *  muestra su ícono grande ("carátula") en el centro. Todo se
 *  maneja con el joystick (eje Y = navegar, click SW = ejecutar).
 *  Al ejecutar hace POST a Hammerspoon: http://HOST:PORT/cmd
 *  con {"type":"action","payload":"<id>"} + header X-Auth-Token.
 * ═══════════════════════════════════════════════
 *  Librerías: Adafruit SSD1306, Adafruit GFX
 *  Cableado: JOY_Y=35  JOY_SW=32  OLED SDA=21 SCL=22
 * ═══════════════════════════════════════════════
 */

#include <WiFi.h>
#include <time.h>
#include <HTTPClient.h>
#include <Wire.h>
#include <Adafruit_GFX.h>
#include <Adafruit_SSD1306.h>
#include "secrets.h"   // SECRET_WIFI_SSID, SECRET_WIFI_PASS, SECRET_HAMMERSPOON_TOKEN

// ---------- CONFIG ----------
const char* WIFI_SSID = SECRET_WIFI_SSID;
const char* WIFI_PASS = SECRET_WIFI_PASS;

const char* HAMMERSPOON_HOST  = "192.168.0.107";
const int   HAMMERSPOON_PORT  = 8484;
const char* HAMMERSPOON_TOKEN = SECRET_HAMMERSPOON_TOKEN;

const long GMT_OFFSET_SEC = -6 * 3600;   // CDMX
const int  DST_OFFSET_SEC = 0;

// ---------- PINES ----------
#define PIN_JOY_Y   35
#define PIN_JOY_SW  32

// ---------- OLED ----------
#define SCREEN_W 128
#define SCREEN_H 64
#define OLED_ADDR 0x3C
Adafruit_SSD1306 display(SCREEN_W, SCREEN_H, &Wire, -1);

// ---------- ICONOS 8x8 ----------
static const uint8_t PROGMEM ICON_SKULL[] = {
  0b00111100, 0b01111110, 0b11011011, 0b11111111,
  0b11100111, 0b01111110, 0b00101010, 0b00000000
};
static const uint8_t PROGMEM ICON_TERMINAL[] = {
  0b11111111, 0b10000001, 0b10111001, 0b10100001,
  0b10000001, 0b11111111, 0b00011000, 0b01111110
};
static const uint8_t PROGMEM ICON_RADIATION[] = {
  0b01100110, 0b11100111, 0b11100111, 0b00011000,
  0b00011000, 0b00011000, 0b00111100, 0b01111110
};
static const uint8_t PROGMEM ICON_GLITCH[] = {   // MUTE
  0b11000011, 0b01100110, 0b00000000, 0b11111111,
  0b00000000, 0b01100110, 0b11000011, 0b00000000
};
static const uint8_t PROGMEM ICON_ARROW_UP[] = {  // VOLUME UP
  0b00011000, 0b00111100, 0b01111110, 0b11111111,
  0b00011000, 0b00011000, 0b00011000, 0b00011000
};
static const uint8_t PROGMEM ICON_ARROW_DOWN[] = { // VOLUME DOWN
  0b00011000, 0b00011000, 0b00011000, 0b00011000,
  0b11111111, 0b01111110, 0b00111100, 0b00011000
};
static const uint8_t PROGMEM ICON_LOCK[] = {       // LOCK
  0b00111100, 0b01000010, 0b01000010, 0b01111110,
  0b11111111, 0b11011011, 0b11011011, 0b11111111
};
static const uint8_t PROGMEM ICON_MOON[] = {       // SLEEP
  0b00111000, 0b01111000, 0b11110000, 0b11110000,
  0b11110000, 0b01111000, 0b00111100, 0b00000000
};

// ---------- IMAGENES ----------
const unsigned char coca [] PROGMEM = {
  0xff, 0xff, 0xff, 0xff, 0xff, 0xff, 0xff, 0xff, 0xff, 0xff, 0xff, 0xff, 0xff, 0xff, 0xff, 0xff,
  0xff, 0xff, 0xff, 0xff, 0xff, 0xff, 0xff, 0xff, 0xff, 0xff, 0xff, 0xff, 0xff, 0xff, 0xff, 0xff,
  0xff, 0xff, 0xff, 0xff, 0xff, 0xff, 0xff, 0xff, 0xff, 0xff, 0xff, 0xff, 0xff, 0xff, 0xff, 0xff,
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  0xff, 0xff, 0xff, 0xff, 0xff, 0xff, 0xff, 0xff, 0xff, 0xff, 0xff, 0xff, 0xff, 0xff, 0xff, 0xff,
};
// Batery
const unsigned char BATTERY [] PROGMEM = {
  0x00, 0x00, 0x00, 0x00, 0x00, 0x00, 0x00, 0x00, 0x3f, 0xf8, 0x40, 0x04, 0x5b, 0x66, 0x5b, 0x66,
  0x5b, 0x66, 0x40, 0x04, 0x3f, 0xf8, 0x00, 0x00, 0x00, 0x00, 0x00, 0x00, 0x00, 0x00, 0x00, 0x00,
};
// Dashboard
const unsigned char DASHBOARD [] PROGMEM = {
  0x07, 0xe0, 0x18, 0x18, 0x21, 0x24, 0x50, 0x02, 0x48, 0x0a, 0x84, 0x01, 0x83, 0x81, 0xa2, 0x45,
  0x82, 0x41, 0x81, 0x81, 0xa0, 0x05, 0x40, 0x02, 0x4b, 0xd2, 0x23, 0xc4, 0x18, 0x18, 0x07, 0xe0,
};
// DVD
const unsigned char DVD [] PROGMEM = {
  0x07, 0xc0, 0x10, 0x10, 0x20, 0x08, 0x40, 0x04, 0x00, 0x10, 0xff, 0xc2, 0x88, 0x42, 0xa1, 0x42,
  0xa1, 0x42, 0x94, 0xc2, 0xff, 0xc6, 0x40, 0x04, 0x60, 0x0c, 0x30, 0x38, 0x0f, 0xe0, 0x00, 0x00,
};
// Terminal
const unsigned char TERMINAL [] PROGMEM = {
  0x7f, 0xfe, 0x80, 0x01, 0xaa, 0xfd, 0x80, 0x01, 0x80, 0x01, 0xbf, 0xfd, 0xaf, 0xfd, 0xb7, 0xfd,
  0xaf, 0xfd, 0xbf, 0xfd, 0xbf, 0xfd, 0xbf, 0xfd, 0xbf, 0xfd, 0x80, 0x01, 0xff, 0xff, 0x7f, 0xfe,
};
// Bike
const unsigned char BIKE [] PROGMEM = {0x00,0x00,0x00,0x00,0x00,0x00,0x00,0x01,0xc0,0x00,0x01,0xc0,0x00,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0x00,0x00};

// ---------- ESTADOS ----------
enum Screen { SCREEN_HOME, SCREEN_DECK };
Screen currentScreen = SCREEN_HOME;

// ---------- MENÚ ----------
struct DeckItem {
  const char* label;
  const char* id;          // nullptr = no dispara HTTP (ej. "< BACK")
  const uint8_t* icon;
};

const DeckItem deckItems[] = {
  { "VOLUME UP",   "volume_up",   ICON_ARROW_UP   },
  { "VOLUME DOWN", "volume_down", ICON_ARROW_DOWN },
  { "MUTE",        "mute_toggle", ICON_GLITCH     },
  { "LOCK",        "lock",        ICON_LOCK       },
  { "SLEEP",       "sleep",       ICON_MOON       },
  { "< BACK",      nullptr,       ICON_TERMINAL   },
};
const int DECK_LEN = sizeof(deckItems) / sizeof(deckItems[0]);
int deckIndex = 0;

// ---------- INPUT ----------
unsigned long lastBtn = 0, lastJoy = 0;
const unsigned long BTN_DEBOUNCE = 250;
const unsigned long JOY_REPEAT  = 180;

// ---------- CURSOR HOME ----------
bool cursorOn = true;
unsigned long lastBlink = 0;

// ═══════════════ SETUP ═══════════════
void setup() {
  Serial.begin(115200);
  pinMode(PIN_JOY_SW, INPUT_PULLUP);

  Wire.begin(21, 22);
  Wire.setClock(400000);
  if (!display.begin(SSD1306_SWITCHCAPVCC, OLED_ADDR)) {
    Serial.println("OLED no encontrado :(");
    while (true) delay(100);
  }

  bootSplash();
  connectWiFi();
  configTime(GMT_OFFSET_SEC, DST_OFFSET_SEC, "mx.pool.ntp.org", "pool.ntp.org");
  drawHome();
}

// ═══════════════ LOOP ═══════════════
void loop() {
  handleInput();

  if (millis() - lastBlink > 500) {
    cursorOn = !cursorOn;
    lastBlink = millis();
  }

  if (currentScreen == SCREEN_HOME) drawHome();
  else                              drawDeck();

  delay(30);
}

// ═══════════════ INPUT ═══════════════
void handleInput() {
  if (currentScreen == SCREEN_HOME) {
    bool sw = (digitalRead(PIN_JOY_SW) == LOW);
    if (sw && millis() - lastBtn > BTN_DEBOUNCE) {
      lastBtn = millis();
      currentScreen = SCREEN_DECK;
      deckIndex = 0;
    }
    return;
  }

  int y = analogRead(PIN_JOY_Y);
  if (millis() - lastJoy > JOY_REPEAT) {
    int dir = 0;
    if (y < 1000)      dir = -1;
    else if (y > 3000) dir = +1;
    if (dir != 0) {
      deckIndex = (deckIndex + dir + DECK_LEN) % DECK_LEN;   // circular, como el menú de referencia
      lastJoy = millis();
    }
  }

  bool sw = (digitalRead(PIN_JOY_SW) == LOW);
  if (sw && millis() - lastBtn > BTN_DEBOUNCE) {
    lastBtn = millis();
    if (deckItems[deckIndex].id == nullptr) {   // "< BACK"
      currentScreen = SCREEN_HOME;
    } else {
      fireAction(deckIndex);
    }
  }
}

// ═══════════════ HAMMERSPOON (HTTP) ═══════════════
void fireResultFlash(bool ok) {
  int times = ok ? 2 : 5;
  int ms    = ok ? 60 : 35;
  for (int i = 0; i < times; i++) {
    display.invertDisplay(true);  delay(ms);
    display.invertDisplay(false); delay(ms);
  }
}

void fireAction(int idx) {
  if (idx < 0 || idx >= DECK_LEN) return;

  if (WiFi.status() != WL_CONNECTED) {
    Serial.println("[HAMMERSPOON] sin wifi");
    fireResultFlash(false);
    return;
  }

  HTTPClient http;
  char url[96];
  snprintf(url, sizeof(url), "http://%s:%d/cmd", HAMMERSPOON_HOST, HAMMERSPOON_PORT);
  http.begin(url);
  http.setTimeout(3000);
  http.addHeader("Content-Type", "application/json");
  http.addHeader("X-Auth-Token", HAMMERSPOON_TOKEN);

  char body[64];
  snprintf(body, sizeof(body), "{\"type\":\"action\",\"payload\":\"%s\"}", deckItems[idx].id);

  int code = http.POST(body);
  http.end();

  Serial.printf("[HAMMERSPOON] %s -> %d\n", deckItems[idx].id, code);
  fireResultFlash(code == 200);
}

// ═══════════════ BITMAP ESCALADO (carátula grande) ═══════════════
void drawBitmapScaled(int16_t x, int16_t y, const uint8_t* bitmap, int w, int h, int scale, uint16_t color) {
  int byteWidth = (w + 7) / 8;
  for (int j = 0; j < h; j++) {
    for (int i = 0; i < w; i++) {
      if (pgm_read_byte(bitmap + j * byteWidth + i / 8) & (0x80 >> (i & 7))) {
        display.fillRect(x + i * scale, y + j * scale, scale, scale, color);
      }
    }
  }
}

// ═══════════════ PANTALLA (estilo Flipper Zero / upir) ═══════════════
// Header (igual al resto de las pantallas) + 3 filas: anterior (chico) /
// seleccionado (resaltado) / siguiente (chico), ícono 16x16 (nuestros
// íconos 8x8 escalados x2) + label, scrollbar a la derecha.
const int DECK_LIST_TOP = 14;   // debajo del header, deja 50px para la lista

void drawDeck() {
  display.clearDisplay();

  // -- header: qué menú es (útil cuando haya submenús) --
  display.fillRect(0, 0, 128, 14, SSD1306_WHITE);
  display.setTextColor(SSD1306_BLACK);
  display.setTextSize(1);
  display.drawBitmap(3, 3, ICON_TERMINAL, 8, 8, SSD1306_BLACK);
  display.setCursor(13, 3);
  display.print(F("DECK"));
  display.setCursor(98, 3);
  display.print(deckIndex + 1);
  display.print("/");
  display.print(DECK_LEN);

  display.setTextColor(SSD1306_WHITE);

  int prevIdx = (deckIndex - 1 + DECK_LEN) % DECK_LEN;
  int nextIdx = (deckIndex + 1) % DECK_LEN;

  // -- caja de selección alrededor del item actual --
  display.drawRoundRect(0, DECK_LIST_TOP + 15, 120, 18, 3, SSD1306_WHITE);

  // -- item anterior --
  drawBitmapScaled(4, DECK_LIST_TOP + 1, deckItems[prevIdx].icon, 8, 8, 2, SSD1306_WHITE);
  display.setCursor(25, DECK_LIST_TOP + 5);
  display.print(deckItems[prevIdx].label);

  // -- item seleccionado ("negrita" con doble trazo) --
  drawBitmapScaled(4, DECK_LIST_TOP + 17, deckItems[deckIndex].icon, 8, 8, 2, SSD1306_WHITE);
  display.setCursor(25, DECK_LIST_TOP + 21);
  display.print(deckItems[deckIndex].label);
  display.setCursor(26, DECK_LIST_TOP + 21);
  display.print(deckItems[deckIndex].label);

  // -- item siguiente --
  drawBitmapScaled(4, DECK_LIST_TOP + 33, deckItems[nextIdx].icon, 8, 8, 2, SSD1306_WHITE);
  display.setCursor(25, DECK_LIST_TOP + 37);
  display.print(deckItems[nextIdx].label);

  // -- scrollbar (solo en el área de la lista, no tapa el header) --
  display.drawRect(122, DECK_LIST_TOP, 6, SCREEN_H - DECK_LIST_TOP, SSD1306_WHITE);
  int handleH = (SCREEN_H - DECK_LIST_TOP) / DECK_LEN;
  display.fillRect(123, DECK_LIST_TOP + handleH * deckIndex, 4, handleH, SSD1306_WHITE);

  display.display();
}

// ═══════════════ PANTALLA HOME ═══════════════
void drawHome() {
  display.clearDisplay();
  drawStatusBar();

  struct tm t;
  bool haveTime = getLocalTime(&t, 50);

  display.drawRect(0, 18, 128, 46, SSD1306_WHITE);
  display.setTextColor(SSD1306_WHITE);
  display.setTextSize(1);

  display.setCursor(6, 22);
  display.print(F(">JUSSEF.SYS ONLINE"));

  display.setCursor(6, 34);
  if (haveTime) {
    char fecha[24];
    strftime(fecha, sizeof(fecha), "%d/%m/%Y>%a", &t);
    display.print(F("DATE: "));
    display.print(fecha);
  } else {
    display.print(F("DATE: SYNCING..."));
  }

  display.setCursor(6, 46);
  display.print(F("IP: "));
  display.print(WiFi.status() == WL_CONNECTED ? WiFi.localIP().toString() : "---");

  if (cursorOn) display.fillRect(6, 56, 6, 4, SSD1306_WHITE);

  display.display();
}

void drawStatusBar() {
  display.setTextColor(SSD1306_WHITE);
  display.setTextSize(1);

  struct tm t;
  display.setCursor(0, 4);
  if (getLocalTime(&t, 50)) {
    char hora[13];
    strftime(hora, sizeof(hora), "%I:%M:%S%p", &t);
    display.print(hora);
  } else {
    display.print(F("--:--:--"));
  }

  display.drawBitmap(70, 3, ICON_RADIATION, 8, 8, SSD1306_WHITE);
  drawWifiBars(104, 12);

  display.drawFastHLine(0, 15, 128, SSD1306_WHITE);
}

void drawWifiBars(int x, int yBase) {
  if (WiFi.status() != WL_CONNECTED) {
    display.setCursor(x, 4);
    display.print(F("X"));
    return;
  }
  long rssi = WiFi.RSSI();
  int bars = (rssi > -55) ? 4 : (rssi > -65) ? 3 : (rssi > -75) ? 2 : 1;
  for (int i = 0; i < 4; i++) {
    int h = 3 + i * 3;
    if (i < bars) display.fillRect(x + i * 5, yBase - h, 3, h, SSD1306_WHITE);
    else          display.drawRect(x + i * 5, yBase - h, 3, h, SSD1306_WHITE);
  }
}

// ═══════════════ BOOT ═══════════════
void bootSplash() {
  display.clearDisplay();
  display.drawBitmap(0, 0, coca, 128, 64, SSD1306_WHITE);
  display.display();
  delay(2500);
}

// ═══════════════ WIFI ═══════════════
void connectWiFi() {
  display.clearDisplay();
  display.setCursor(0, 0);
  display.setTextColor(SSD1306_WHITE);
  display.print(F("WIFI: CONNECTING"));
  display.display();

  WiFi.mode(WIFI_STA);
  WiFi.begin(WIFI_SSID, WIFI_PASS);

  int dots = 0;
  while (WiFi.status() != WL_CONNECTED && dots < 40) {
    delay(250);
    display.print(".");
    display.display();
    dots++;
  }
}
